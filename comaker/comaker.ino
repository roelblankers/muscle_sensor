#include <PCM.h>
#include <Wire.h>
#include <hd44780.h>
#include <hd44780ioClass/hd44780_I2Cexp.h> 

hd44780_I2Cexp lcd; // declare lcd object: auto locate & config display for hd44780 chip

int sensorPin = A0;    // spiersensor
int refPin = A1;    // referentie signaal
int audioPin = 10;      // audio output
int transmitPin = 11; // transmit voor switchen apparaat
int sensorValue = 0;  // variable to store the value coming from the sensor
int refValue = 0;  // variable to store the value coming from the sensor
int wisselPin = A2;
int wissel = 0;
boolean state = 1;

const unsigned char sample[] PROGMEM = {
  126, 126, 127, 127, 127, 127, 127, 127, 127, 128, 128, 128,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 128, 
};

void transmit(){
  if(wissel == 1){
    if (sensorValue > refValue){
      if (state == 1){
        digitalWrite (13,1);
        digitalWrite(transmitPin, 1);
        state = 0;
      }
    }
  }
}

void setup() {
  pinMode(13,OUTPUT);
  pinMode(audioPin, OUTPUT);
  pinMode(refPin, INPUT);
  pinMode(transmitPin, OUTPUT);
  lcd.begin(16, 2);
  lcd.init();
  lcd.backlight();
  lcd.home();
}

void dingen(){ //booleaanse staat weer op 1 zetten na het ontspannen van de spieren
  if (sensorValue < refValue){
    state = 1;
    digitalWrite (transmitPin,0);
    digitalWrite (13,0);
  }
}

void uart(){  //adc uitlezen en printen
  Serial.begin(9600);
  sensorValue = analogRead(sensorPin);
  refValue    = analogRead(refPin);
  Serial.print("Sensor = ");
  Serial.print(sensorValue);
  Serial.print("\tReferentie = ");
  Serial.println(refValue);
  }

void sound(){ //muziek afspelen na threshold waarde
  if (wissel == 0){
    if (sensorValue > refValue){
      if (state == 1){
        digitalWrite(audioPin, HIGH);
        startPlayback(sample, sizeof(sample));
        state = 0;
      }
    }
  }
}

void loop() { //functies oproepen
  lcd.setCursor(0,0);
  lcd.print("Referentie :");
  lcd.print(analogRead(refPin));
  lcd.setCursor(0,1);
  lcd.print("Spiersensor:");
  lcd.print(analogRead(sensorPin));  
  delay(100);
  lcd.clear();  
  uart();
  sound();
  dingen();
  transmit();
}
